## config/boards/shields/infinix/Kconfig.defconfig
```kconfig
if SHIELD_INFINIX_LEFT || SHIELD_INFINIX_RIGHT

config ZMK_KEYBOARD_NAME
    default "Infinix"

endif
```

## config/boards/shields/infinix/Kconfig.shield
```kconfig
config SHIELD_INFINIX_LEFT
    def_bool $(shields_list_contains,infinix_left)

config SHIELD_INFINIX_RIGHT
    def_bool $(shields_list_contains,infinix_right)
```
