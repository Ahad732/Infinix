/ {
    kscan0: kscan {
        compatible = "zmk,kscan-gpio-matrix";
        diode-direction = "col2row";

        row-gpios = <
            <&gpio1 15 (GPIO_ACTIVE_HIGH | GPIO_PULL_DOWN)>
            <&gpio1 14 (GPIO_ACTIVE_HIGH | GPIO_PULL_DOWN)>
            <&gpio1 13 (GPIO_ACTIVE_HIGH | GPIO_PULL_DOWN)>
            <&gpio1 12 (GPIO_ACTIVE_HIGH | GPIO_PULL_DOWN)>
            <&gpio1 11 (GPIO_ACTIVE_HIGH | GPIO_PULL_DOWN)>
        >;

        col-gpios = <
            <&gpio0 3 GPIO_ACTIVE_HIGH>
            <&gpio0 28 GPIO_ACTIVE_HIGH>
            <&gpio0 29 GPIO_ACTIVE_HIGH>
            <&gpio0 4 GPIO_ACTIVE_HIGH>
            <&gpio0 5 GPIO_ACTIVE_HIGH>
        >;

        debounce-press-ms = <5>;
        debounce-release-ms = <5>;
    };

    matrix_transform: matrix_transform {
        compatible = "zmk,matrix-transform";

        rows = <5>;
        columns = <5>;

        map = <

        >;
    };
};
